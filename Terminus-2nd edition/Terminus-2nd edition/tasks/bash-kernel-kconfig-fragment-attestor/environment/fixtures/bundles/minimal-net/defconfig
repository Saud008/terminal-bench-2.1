## Terminus-2nd edition/Terminus-2nd edition/tasks/bash-kernel-kconfig-fragment-attestor/environment/fixtures/bundles/minimal-net/defconfig
```kconfig
CONFIG_NET=n
CONFIG_INET=n
CONFIG_PACKET=y
# CONFIG_DEVMEM is not set
CONFIG_DEBUG_KERNEL=n
```
